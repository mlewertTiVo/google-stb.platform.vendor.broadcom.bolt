/***************************************************************************
 *     Copyright (c) 2012-2014, Broadcom Corporation
 *     All Rights Reserved
 *     Confidential Property of Broadcom Corporation
 *
 *  THIS SOFTWARE MAY ONLY BE USED SUBJECT TO AN EXECUTED SOFTWARE LICENSE
 *  AGREEMENT  BETWEEN THE USER AND BROADCOM.  YOU HAVE NO RIGHT TO USE OR
 *  EXPLOIT THIS MATERIAL EXCEPT SUBJECT TO THE TERMS OF SUCH AN AGREEMENT.
 * 
 ***************************************************************************/

SECTIONS {
	.shmoo.board 0x00000000 :
	{
	 	* (.board);
	}

	.shmoo.mcb :
	{
	 	* (.mcbtable);
	}

	.shmoo.submcb :
	{
	 	* (.mcbsubtable);
	}

	.shmoo.mcbdata :
	{
		* (.mcbdata);
	}
};
