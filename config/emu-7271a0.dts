/dts-v1/;

/include/ "family-7271.dtsi"
/include/ "common.dtsi"
/include/ "A53.dtsi"


/ {
	model = "Broadcom STB (7271a0)";
	compatible = "brcm,bcm7271a0", "brcm,brcmstb";

	chosen {
		/* For kernels with earlycon */
		bootargs = "initcall_debug console=ttyS0,115200 earlycon=uart8250,mmio32,0xf040c000,115200n8 debug";
		/* For kernels with early printk */
/*		bootargs = "initcall_debug console=ttyS0,115200 earlyprintk=uart8250-32bit,0xf040c000 bcm_full_clk=0 mem=1G debug";*/
	};

};
