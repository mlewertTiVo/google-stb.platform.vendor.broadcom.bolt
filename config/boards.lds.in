/***************************************************************************
 * Broadcom Proprietary and Confidential. (c)2016 Broadcom. All rights reserved.
 *
 *  THIS SOFTWARE MAY ONLY BE USED SUBJECT TO AN EXECUTED SOFTWARE LICENSE
 *  AGREEMENT  BETWEEN THE USER AND BROADCOM.  YOU HAVE NO RIGHT TO USE OR
 *  EXPLOIT THIS MATERIAL EXCEPT SUBJECT TO THE TERMS OF SUCH AN AGREEMENT.
 * 
 ***************************************************************************/

SECTIONS {
	.boards.header 0x00000000 :
	{
	 	* (.header);
	} =@FILLB@

	.boards.rodata :
	{
		* (.rodata)
		* (.rodata.*)
	} =@FILLB@

	.boards.pmaptable : ALIGN(4)
	{
		* (.pmaptable)
	} =@FILLB@
};
